## components/encoder/Kconfig
```kconfig
menu "PluTO encoders"

    comment "Compiled in: changing anything here means reflashing."

    config PLUTO_ENCODERS
        bool "Read the servo angles from AS5600 encoders"
        default n
        help
            Reads each axis from an AS5600 on an I2C bus of its own and
            reports the measured position and the tracking error in the state
            (meas and err_cdeg, device-state.md). Off, both go out as null and
            nothing touches the I2C pins (fixed in main.c: pan on 21/22, tilt
            on 32/33). Off until the encoders are mounted: the chip is not
            confirmed yet.

endmenu
```

## components/motion_profile/Kconfig
```kconfig
menu "PluTO motion profile"

    comment "Starting points: tune them on the bench with the antenna mounted."
    comment "Compile-time constants, unlike the NVS seeds: change, rebuild, flash."

    config PLUTO_MOTION_MAX_SPEED_DEG_S
        int "Top speed of each servo axis (degrees per second)"
        default 60
        range 1 600
        help
            Top speed per axis (HU-36). Below about 20 the pan falls behind
            near the zenith (test_a_high_pass_keeps_up in the rotor tests).

    config PLUTO_MOTION_MAX_ACCEL_DEG_S2
        int "Top acceleration of each servo axis (degrees per second squared)"
        default 120
        range 1 5000
        help
            Top acceleration and deceleration per axis, the braking after a
            HOLD included (HU-36): it spares the gears the jerk of a jump. Too
            low and high passes fall behind as well.

    config PLUTO_MOTION_REST_AFTER_MS
        int "Time still before the servo outputs can be released (ms)"
        default 5000
        range 0 3600000
        help
            Once both axes have been still at the same target this long, both
            servo outputs are released until the next target (HU-35). 0 never
            releases them. If the tilt sags under the antenna without pulses
            (still to be measured), lengthen it or set 0.

endmenu
```

## components/servo/Kconfig
```kconfig
menu "PluTO servos"

    comment "The version and the pins are compiled in: changing one means reflashing."
    comment "The pulses only seed the mount calibration in NVS, like the PLUTO_CAL_* values."

    choice PLUTO_SERVO_DS3218_VERSION
        prompt "DS3218 version"
        default PLUTO_SERVO_DS3218_270
        help
            The DS3218 comes in a 180-degree and a 270-degree version. Both
            take 500-2500 us but spread it over different angles, so the
            version sets the default pulses below. The mount uses 180 degrees
            of either.

            The 270-degree version is the default on purpose. Set to 180 while
            the servo is a 270, it would turn 90 degrees further than asked and
            stretch the cable loops. Set to 270 while the servo is a 180, it
            only falls about 60 degrees short.

            To tell them apart on the bench, send 1000 us and then 2000 us:
            the horn turns about 90 degrees on the 180-degree version and about
            135 on the 270-degree one.

            Changing the version once sdkconfig exists does not change the
            pulses already saved in it: they count as set by hand. Set the
            four pulses again, or delete their lines from sdkconfig and run
            idf.py reconfigure to get the new version's defaults. And since
            the pulses only seed NVS, a board that already stored them needs
            PLUTO_FORCE_KCONFIG_SEED for one boot to take the new ones.

        config PLUTO_SERVO_DS3218_180
            bool "180 degrees"

        config PLUTO_SERVO_DS3218_270
            bool "270 degrees"
    endchoice

    config PLUTO_SERVO_PAN_GPIO
        int "Pan servo signal GPIO"
        range 0 33
        default 25
        help
            The driver refuses the pins that are unsafe for a servo signal:
            the strapping pins 0, 2, 5, 12 and 15, the flash on 6-11, UART0 on
            1 and 3, and 14, which puts out PWM during boot. 34-39 are inputs
            only. Keep 21/22 and 32/33 free as well, for the I2C buses of the
            encoders.

    config PLUTO_SERVO_TILT_GPIO
        int "Tilt servo signal GPIO"
        range 0 33
        default 26
        help
            Same rules as the pan pin, and a different pin from it.

    comment "Two-point calibration: the pulse that puts each servo at 0 and at 180 degrees."
    comment "It covers trim, scale and direction; reverse a servo by swapping the two."
    comment "First-boot seed: once NVS holds the calibration, the stored pulses win."

    config PLUTO_SERVO_PAN_US_AT_0
        int "Pan pulse at 0 degrees (us)"
        range 500 2500
        default 500 if PLUTO_SERVO_DS3218_180
        default 834
        help
            Pulse width that puts the pan servo at 0 degrees. The default is
            the nominal one for the version above (SERVO_CALIBRATION_DS3218_*
            in servo_pulse.h). Measure the real one on the bench.

            Seeds NVS when it holds no calibration yet; afterwards the stored
            value wins, until PLUTO_FORCE_KCONFIG_SEED re-seeds it. A pair
            with both points equal keeps the servos stopped, with an error in
            the log.

    config PLUTO_SERVO_PAN_US_AT_180
        int "Pan pulse at 180 degrees (us)"
        range 500 2500
        default 2500 if PLUTO_SERVO_DS3218_180
        default 2166
        help
            Pulse width that puts the pan servo at 180 degrees.

    config PLUTO_SERVO_TILT_US_AT_0
        int "Tilt pulse at 0 degrees (us)"
        range 500 2500
        default 500 if PLUTO_SERVO_DS3218_180
        default 834
        help
            Pulse width that puts the tilt servo at 0 degrees, the horizon
            ahead.

    config PLUTO_SERVO_TILT_US_AT_180
        int "Tilt pulse at 180 degrees (us)"
        range 500 2500
        default 2500 if PLUTO_SERVO_DS3218_180
        default 2166
        help
            Pulse width that puts the tilt servo at 180 degrees, the horizon
            behind.

endmenu
```
